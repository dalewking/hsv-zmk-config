## boards/shields/hillside_view/Kconfig.shield
```kconfig
config SHIELD_HILLSIDE_VIEW_LEFT
    def_bool $(shields_list_contains,hillside_view_left)

config SHIELD_HILLSIDE_VIEW_RIGHT
    def_bool $(shields_list_contains,hillside_view_right)
```
